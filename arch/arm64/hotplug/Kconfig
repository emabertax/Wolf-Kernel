## arch/arm64/hotplug/Kconfig
```kconfig
config ASMP
 	bool "Multi-core automatic hotplug support"
 	depends on SMP
 	default n
 	help
 	Automatically hotplugs the multiple cpu cores on and off
 	based on cpu load and suspend stat

          Note that this will BREAK any runtime patching of the kernel text
          (i.e. anything that uses apply_alternatives,
          aarch64_insn_patch_text_nosync, etc. including the various CPU
          errata workarounds in arch/arm64/kernel/cpu_errata.c).

	  For MPU based protection-enabled targets please refer to
	  MSM_KERNEL_PROTECT_MPU

config THUNDERPLUG_CONTROL
	bool "Enable plugging down/up of cores based on load per core"
	depends on SMP && HOTPLUG_CPU
	default n
	help
	  This driver hotplugs cpu cores based on per-core load
```
